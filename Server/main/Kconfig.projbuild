## Server/main/Kconfig.projbuild
```kconfig
menu "Parking TFT display"

config PARKING_LCD_SCLK_GPIO
    int "SPI clock GPIO"
    range 0 21
    default 4

config PARKING_LCD_MOSI_GPIO
    int "SPI MOSI/SDA GPIO"
    range 0 21
    default 6

config PARKING_LCD_DC_GPIO
    int "Display data/command GPIO"
    range 0 21
    default 7

config PARKING_LCD_RST_GPIO
    int "Display reset GPIO"
    range -1 21
    default 3

config PARKING_LCD_CS_GPIO
    int "Display chip-select GPIO"
    range -1 21
    default 10

config PARKING_LCD_BL_GPIO
    int "Display backlight GPIO (-1 if tied on)"
    range -1 21
    default 5

config PARKING_LCD_X_GAP
    int "Panel X offset"
    range 0 320
    default 0

config PARKING_LCD_Y_GAP
    int "Panel Y offset"
    range 0 320
    default 0

endmenu

menu "Parking network and security"

config PARKING_WIFI_SSID
    string "Shared Wi-Fi SSID (server and both clients join it; needs Internet for SePay)"
    default "Parking"

config PARKING_WIFI_PASSWORD
    string "Shared Wi-Fi password"
    default "12345678"

config PARKING_ADMIN_PIN
    string "Dashboard admin PIN (barrier control, clock, cash payment)"
    default "2468"

endmenu

menu "Parking QR payment (SePay)"

config PARKING_PAY_BANK_BIN
    string "Bank BIN (6 digits, BIDV = 970418)"
    default "970418"

# Renamed from PARKING_PAY_ACCOUNT / PARKING_SEPAY_TOKEN so values left in older sdkconfig
# files (the main BIDV account, a revoked token) no longer override these defaults.
config PARKING_PAY_VA
    string "96247V4VYM"
    default "96247V4VYM"
    help
        The number put in the QR. SePay only sees transfers to a personal BIDV
        account when they go to a virtual account (VA): enter the VA number from
        my.sepay.vn (Bank accounts > VA), not the main account number.

config PARKING_PAY_ACCOUNT_NAME
    string "Account holder name shown on the TFT (no accents)"
    default "SMART PARKING"

config PARKING_SEPAY_API_TOKEN
    string "EVDQCLT9TKNH3GZEGUTDSAMXZYHWRAS25JD90IRZDX0OYRI1TQI7KXPVPKOEACLH"
    default "EVDQCLT9TKNH3GZEGUTDSAMXZYHWRAS25JD90IRZDX0OYRI1TQI7KXPVPKOEACLH"
    help
        Created in my.sepay.vn > Cau hinh > API Access. It has full access to the SePay
        account, so keep it only in the git-ignored sdkconfig.

config PARKING_PAY_TIMEOUT_S
    int "Seconds to wait for the transfer before showing PAY AT BOOTH"
    range 30 900
    default 180

config PARKING_PAY_POLL_MS
    int "SePay polling interval while a payment is pending (ms)"
    range 1000 30000
    default 3000

endmenu
```
