#include "claude_gif.h"

#define CLAUDE_PIXELS (CLAUDE_WIDTH * CLAUDE_HEIGHT)

/* Cropped, panel-matted RGB565 frames, LZSS compressed from claude.gif.
 * Pixels are pre-byte-swapped for the ST7789 so the firmware only decodes them. */
const uint16_t claude_frame_delay_ms[CLAUDE_FRAME_COUNT] = {
    460, 180, 240, 260, 160, 180, 180, 160, 180,
    180, 160, 180, 160, 180, 170, 160, 270, 190,
};
static const uint32_t frame_offsets[CLAUDE_FRAME_COUNT + 1] = {
    0, 672, 1382, 2092, 2840, 3612, 4511, 5517,
    6544, 7588, 8594, 9621, 10665, 11671, 12698, 13731,
    14847, 15547, 16204,
};
static const uint8_t compressed_frames[] = {
    0xFE, 0x08, 0x41, 0x0F, 0x00, 0x0F, 0x00, 0x0F, 0x00, 0x0F, 0x00, 0x0F, 0x00, 0x0F, 0x00, 0x0F,
    0x00, 0xFF, 0x0F, 0x00, 0x0F, 0x00, 0x0F, 0x00, 0x0F, 0x00, 0x0F, 0x00, 0x0F, 0x00, 0x0F, 0x00,
    0x0F, 0x00, 0xFF, 0x0F, 0x00, 0x0F, 0x00, 0x0F, 0x00, 0x0F, 0x00, 0x0F, 0x00, 0x0F, 0x00, 0x0F,
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    0x00, 0x0F, 0x3F, 0x04, 0x3F, 0x04, 0x3F, 0x04, 0x0F, 0x00, 0x08, 0x41,
};

bool claude_decode_frame(size_t frame_index, uint16_t *pixels, size_t pixel_count)
{
    if (frame_index >= CLAUDE_FRAME_COUNT || pixels == NULL || pixel_count != CLAUDE_PIXELS)
        return false;

    size_t input = frame_offsets[frame_index];
    const size_t input_end = frame_offsets[frame_index + 1];
    size_t output = 0;
    while (input < input_end && output < pixel_count)
    {
        const uint8_t flags = compressed_frames[input++];
        for (unsigned bit = 0; bit < 8 && output < pixel_count; ++bit)
        {
            if (flags & (1U << bit))
            {
                if (input_end - input < 2)
                    return false;
                const uint16_t code = (uint16_t)compressed_frames[input] |
                                      ((uint16_t)compressed_frames[input + 1] << 8);
                input += 2;
                const size_t distance = (code >> 4) + 1;
                const size_t length = (code & 0x0f) + 3;
                if (distance > output || length > pixel_count - output)
                    return false;
                for (size_t i = 0; i < length; ++i)
                    pixels[output + i] = pixels[output + i - distance];
                output += length;
            }
            else
            {
                if (input_end - input < 2)
                    return false;
                pixels[output++] = (uint16_t)compressed_frames[input] |
                                   ((uint16_t)compressed_frames[input + 1] << 8);
                input += 2;
            }
        }
    }
    return output == pixel_count && input == input_end;
}
